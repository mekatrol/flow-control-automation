## controllers/kincony/kc868-a16/main/Kconfig.projbuild
```kconfig
menu "KC868-A16v3 controller"

    config KC868_A16_WIFI_SSID
        string "Wi-Fi SSID"
        default ""
        help
            Configure this with menuconfig. sdkconfig is ignored, so the real
            network name is not committed to source control.

    config KC868_A16_WIFI_PASSWORD
        string "Wi-Fi password"
        default ""
        help
            Configure this with menuconfig. sdkconfig is ignored, so the real
            network password is not committed to source control.

endmenu
```

## controllers/main/Kconfig.projbuild
```kconfig
menu "Flow controller"

    config CONTROLLER_SETTINGS_MASTER_KEY_HEX
        string "Settings encryption master key (64 hexadecimal characters)"
        default ""
        help
            Provision only in ignored local sdkconfig. The platform derives a
            device-bound AES-256-GCM key from this value and the factory identity.
            Empty or malformed values leave persistent settings unavailable.

    config CONTROLLER_SETTINGS_FIRST_RESERVED_SECTOR
        int "First SD sector reserved exclusively for controller settings"
        range 0 2147483647
        default 0
        help
            Zero disables raw settings storage. Provision a nonzero start sector
            for a dedicated 16-sector area outside all partitions and filesystems.
            Firmware never writes outside that explicitly reserved area.

    config CONTROLLER_WIFI_POWER_SAVE
        bool "Enable minimum modem Wi-Fi power save"
        default y
        help
            Uses minimum modem power saving while preserving automatic DTIM
            wake-up. Disable this when commissioning latency-sensitive flows.

    config CONTROLLER_ETHERNET_ENABLED
        bool "Enable W5500 Ethernet"
        default y
        help
            Enables the board-described W5500 interface and supervised DHCP.

    config CONTROLLER_RS485_ENABLED
        bool "Enable first RS485 port"
        default y
        help
            Enables UART1 on the board-described automatic-direction transceiver.

    config CONTROLLER_RS485_BAUD_RATE
        int "RS485 baud rate"
        range 300 3000000
        default 115200

    config CONTROLLER_RS485_DATA_BITS
        int "RS485 data bits"
        range 7 8
        default 8

    config CONTROLLER_RS485_PARITY
        int "RS485 parity (0 none, 1 even, 2 odd)"
        range 0 2
        default 0

    config CONTROLLER_RS485_STOP_BITS
        int "RS485 stop bits (0 one, 1 two)"
        range 0 1
        default 0

    config CONTROLLER_RS485_RECEIVE_TIMEOUT_MS
        int "RS485 raw-frame inter-byte timeout in milliseconds"
        range 1 10000
        default 20

    config CONTROLLER_RS485_MAXIMUM_FRAME_SIZE
        int "RS485 maximum frame size"
        range 1 256
        default 256

    config CONTROLLER_RS485_TRANSMIT_QUEUE_DEPTH
        int "RS485 transmit frame queue depth"
        range 1 8
        default 8

    config CONTROLLER_RS485_RECEIVE_QUEUE_DEPTH
        int "RS485 receive frame queue depth"
        range 1 8
        default 8

    config CONTROLLER_MQTT_KEEPALIVE_SECONDS
        int "MQTT keepalive interval in seconds"
        range 1 65535
        default 60

    config CONTROLLER_MQTT_PERSISTENT_SESSION
        bool "Request a persistent MQTT session"
        default n

    choice CONTROLLER_MQTT_LINK_POLICY
        prompt "MQTT network link policy"
        default CONTROLLER_MQTT_LINK_AUTOMATIC

        config CONTROLLER_MQTT_LINK_AUTOMATIC
            bool "Automatic priority and failover"

        config CONTROLLER_MQTT_LINK_WIFI
            bool "Bind to Wi-Fi"

        config CONTROLLER_MQTT_LINK_ETHERNET
            bool "Bind to Ethernet"
    endchoice

    config CONTROLLER_MQTT_INITIAL_BACKOFF_MS
        int "MQTT initial reconnect delay in milliseconds"
        range 1 3600000
        default 1000

    config CONTROLLER_MQTT_MAXIMUM_BACKOFF_MS
        int "MQTT maximum reconnect delay in milliseconds"
        range 1 3600000
        default 60000

    config CONTROLLER_MQTT_BACKOFF_JITTER_PERCENT
        int "MQTT reconnect jitter percentage"
        range 0 100
        default 20

endmenu
```
